## conf/layer.conf
```bitbake
# We have a conf and classes directory, add to BBPATH
BBPATH .= ":${LAYERDIR}"

LAYERSERIES_COMPAT_swupdate-delia = "dunfell gatesgarth hardknott"

LAYERDEPENDS_swupdate-delia = "openembedded-layer"
```
